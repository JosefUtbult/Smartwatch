## Software/br2_external/configs/smartwatch_defconfig
```kconfig
BR2_arm=y
BR2_cortex_a7=y
BR2_ARM_FPU_VFPV4=y
BR2_PACKAGE_HOST_LINUX_HEADERS_CUSTOM_4_10=y
BR2_TOOLCHAIN_BUILDROOT_WCHAR=y
BR2_PTHREADS=y
BR2_TOOLCHAIN_BUILDROOT_CXX=y
BR2_TARGET_GENERIC_HOSTNAME="nanopi-neo"
BR2_TARGET_GENERIC_ISSUE="Welcome to Buildroot for the NanoPi NEO"
BR2_ROOTFS_OVERLAY="../br2_external/rootfs_overlay"
BR2_ROOTFS_POST_IMAGE_SCRIPT="../br2_external/scripts/preimagebuild.sh support/scripts/genimage.sh"
BR2_ROOTFS_POST_SCRIPT_ARGS="-c ../br2_external/misc/genimage.cfg"
BR2_LINUX_KERNEL=y
BR2_LINUX_KERNEL_CUSTOM_GIT=y
BR2_LINUX_KERNEL_CUSTOM_REPO_URL="git@github.com:JosefUtbult/Smartwatch-Linux.git"
BR2_LINUX_KERNEL_CUSTOM_REPO_VERSION="smartwatch"
BR2_LINUX_KERNEL_DEFCONFIG="smartwatch"
BR2_LINUX_KERNEL_DTS_SUPPORT=y
BR2_LINUX_KERNEL_INTREE_DTS_NAME="sun8i-h3-nanopi-neo"
BR2_LINUX_KERNEL_INSTALL_TARGET=y
BR2_PACKAGE_GIT=y
BR2_PACKAGE_PIXMAN=y
BR2_PACKAGE_DTC=y
BR2_PACKAGE_LIBGLIB2=y
BR2_TARGET_ROOTFS_EXT2=y
BR2_TARGET_ROOTFS_EXT2_4=y
# BR2_TARGET_ROOTFS_TAR is not set
BR2_PACKAGE_HOST_DOSFSTOOLS=y
BR2_PACKAGE_HOST_DTC=y
BR2_PACKAGE_HOST_GENIMAGE=y
BR2_PACKAGE_HOST_MTOOLS=y
BR2_PACKAGE_HOST_UBOOT_TOOLS=y
BR2_PACKAGE_HOST_UBOOT_TOOLS_BOOT_SCRIPT=y
BR2_PACKAGE_HOST_UBOOT_TOOLS_BOOT_SCRIPT_SOURCE="board/friendlyarm/nanopi-neo/boot.cmd"
```
